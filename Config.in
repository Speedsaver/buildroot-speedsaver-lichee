## packages/Config.in
```kconfig
menu "Target packages"

menu "Userspace utilities"

source "$BR2_EXTERNAL_SPEEDSAVER_LICHEE_PATH/packages/arduipi-oled/Config.in"
source "$BR2_EXTERNAL_SPEEDSAVER_LICHEE_PATH/packages/curtail/Config.in"
source "$BR2_EXTERNAL_SPEEDSAVER_LICHEE_PATH/packages/navit/Config.in"

endmenu

endmenu
```

## packages/navit/Config.in
```kconfig
config BR2_PACKAGE_NAVIT
	bool "Speedsaver navit"
	select BR2_PACKAGE_ARDUIPI_OLED
	select BR2_PACKAGE_LIBGLIB2
	select BR2_PACKAGE_GPSD
	help
	  The OpenSource vector based navigation software

	  http://www.navit-project.org
```
